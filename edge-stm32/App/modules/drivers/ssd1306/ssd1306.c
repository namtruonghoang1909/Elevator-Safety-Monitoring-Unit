/**
 * @file ssd1306.c
 * @brief SSD1306 OLED display driver implementation for STM32
 * 
 * Ported from ESP32 version for maximum symmetry.
 */

#include "ssd1306.h"
#include <string.h>

static uint8_t g_ssd1306_addr = SSD1306_I2C_ADDR;

// ─────────────────────────────────────────────
// Font (Extracted from font.h)
// ─────────────────────────────────────────────
static const uint8_t FONT_5X7[] = {
    0x00, 0x00, 0x00, 0x00, 0x00, // (space)
    0x00, 0x00, 0x5f, 0x00, 0x00, // !
    0x00, 0x07, 0x00, 0x07, 0x00, // "
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    0x10, 0x08, 0x08, 0x10, 0x08, // ~
};

// ─────────────────────────────────────────────
// Private helpers
// ─────────────────────────────────────────────

static bsp_i2c_status_t ssd1306_send_command(uint8_t cmd) {
    uint8_t buf[2] = {0x00, cmd};
    return bsp_i2c_write_bytes(g_ssd1306_addr, buf, 2);
}

static bsp_i2c_status_t ssd1306_send_commands(const uint8_t *cmds, size_t len) {
    uint8_t buf[len + 1];
    buf[0] = 0x00;
    memcpy(&buf[1], cmds, len);
    return bsp_i2c_write_bytes(g_ssd1306_addr, buf, len + 1);
}

// ─────────────────────────────────────────────
// Core APIs
// ─────────────────────────────────────────────

bsp_i2c_status_t ssd1306_init(const ssd1306_config_t *cfg) {
    if (cfg == NULL) return BSP_I2C_ERROR;
    g_ssd1306_addr = cfg->address;

    HAL_Delay(100);

    const uint8_t init_sequence[] = {
        0xAE,               // Display OFF
        0xD5, 0x80,         // Clock divide
        0xA8, 0x3F,         // Multiplex ratio
        0xD3, 0x00,         // Display offset
        0x40 | 0x00,        // Start line
        0x8D, 0x14,         // Charge pump
        0x20, 0x00,         // Memory addressing mode = Horizontal
        0xA1,               // Segment remap
        0xC8,               // COM scan reverse
        0xDA, 0x12,         // COM pins HW config
        0x81, cfg->contrast, // Contrast
        0xD9, 0xF1,         // Pre-charge
        0xDB, 0x40,         // VCOMH level
        0xA4,               // RAM content
        0xA6,               // Normal display
        0xAF                // Display ON
    };

    bsp_i2c_status_t ret = ssd1306_send_commands(init_sequence, sizeof(init_sequence));
    if (ret != BSP_I2C_OK) return ret;

    return ssd1306_clear();
}

bsp_i2c_status_t ssd1306_display_on(void) { return ssd1306_send_command(0xAF); }
bsp_i2c_status_t ssd1306_display_off(void) { return ssd1306_send_command(0xAE); }

bsp_i2c_status_t ssd1306_clear(void) {
    bsp_i2c_status_t ret;

    // Set Horizontal addressing mode range
    ret = ssd1306_send_command(0x21); // Column address
    if (ret != BSP_I2C_OK) return ret;
    ret = ssd1306_send_command(0x00); // Start
    if (ret != BSP_I2C_OK) return ret;
    ret = ssd1306_send_command(127);  // End
    if (ret != BSP_I2C_OK) return ret;

    ret = ssd1306_send_command(0x22); // Page address
    if (ret != BSP_I2C_OK) return ret;
    ret = ssd1306_send_command(0x00); // Start
    if (ret != BSP_I2C_OK) return ret;
    ret = ssd1306_send_command(0x07); // End
    if (ret != BSP_I2C_OK) return ret;

    uint8_t zero_line[128] = {0};
    for (int i = 0; i < 8; i++) {
        ssd1306_set_cursor(i, 0);
        ssd1306_write_data(zero_line, 128);
    }
    return BSP_I2C_OK;
}

bsp_i2c_status_t ssd1306_set_cursor(uint8_t page, uint8_t col) {
    bsp_i2c_status_t ret;
    ret = ssd1306_send_command(0xB0 | (page & 0x07));
    if (ret != BSP_I2C_OK) return ret;
    ret = ssd1306_send_command(0x00 | (col & 0x0F));
    if (ret != BSP_I2C_OK) return ret;
    ret = ssd1306_send_command(0x10 | ((col >> 4) & 0x0F));
    return ret;
}

bsp_i2c_status_t ssd1306_write_data(const uint8_t *data, size_t len) {
    uint8_t buf[len + 1];
    buf[0] = 0x40; // Data mode
    memcpy(&buf[1], data, len);
    return bsp_i2c_write_bytes(g_ssd1306_addr, buf, len + 1);
}

bsp_i2c_status_t ssd1306_write_char(char c, uint8_t page, uint8_t col) {
    if (c < 32 || c > 126) c = '?';
    ssd1306_set_cursor(page, col);
    return ssd1306_write_data(&FONT_5X7[(c - 32) * 5], 5);
}

bsp_i2c_status_t ssd1306_write_string(const char *str, uint8_t page, uint8_t col) {
    bsp_i2c_status_t ret = BSP_I2C_OK;
    uint8_t current_col = col;
    while (*str) {
        if (current_col + 6 > SSD1306_WIDTH) break;
        ret = ssd1306_write_char(*str++, page, current_col);
        if (ret != BSP_I2C_OK) return ret;
        current_col += 6;
    }
    return ret;
}
